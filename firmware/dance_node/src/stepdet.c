#include "stepdet.h"
#include "fusion.h"
#include <math.h>
#include "haptic.h"
#include "dt_port.h"
#include "FreeRTOS.h"
#include "task.h"
#include "queue.h"

static const char *TAG = "stepdet";
extern QueueHandle_t window_q;

// Per-channel int8 scales: value_int8 = clamp(value / scale * 127).
// Generated by ml/export.py into model_scales.h; defaults here until then.
static const float scales[WIN_CHANNELS] = {
    16.0f, 16.0f, 16.0f,        // sensor accel, g
    2000.0f, 2000.0f, 2000.0f,  // gyro, dps
    8.0f, 8.0f, 8.0f,           // world accel, g
};

static int8_t q8(float v, float scale)
{
    float x = v / scale * 127.0f;
    if (x > 127.0f) x = 127.0f;
    if (x < -128.0f) x = -128.0f;
    return (int8_t)lrintf(x);
}

static void cut_window(uint32_t strike_idx, step_window_t *w)
{
    fused_sample_t f;
    for (int i = 0; i < WIN_LEN; i++) {
        uint32_t idx = strike_idx - WIN_PRE_SAMPLES + i;
        if (!fusion_get(idx, &f)) {
            for (int c = 0; c < WIN_CHANNELS; c++) w->x[i][c] = 0;
            continue;
        }
        w->x[i][0] = q8(f.raw.ax, scales[0]);
        w->x[i][1] = q8(f.raw.ay, scales[1]);
        w->x[i][2] = q8(f.raw.az, scales[2]);
        w->x[i][3] = q8(f.raw.gx, scales[3]);
        w->x[i][4] = q8(f.raw.gy, scales[4]);
        w->x[i][5] = q8(f.raw.gz, scales[5]);
        w->x[i][6] = q8(f.ax_f, scales[6]);
        w->x[i][7] = q8(f.ay_f, scales[7]);
        w->x[i][8] = q8(f.az_f, scales[8]);
    }
}

// Strike = |a| peak above STRIKE_PEAK_G, followed by STRIKE_STILL_MS of
// world-frame |a| below STRIKE_STILL_G (foot planted). The window is cut
// WIN_POST_SAMPLES after the peak, so detection latency is ~200 ms + still check.
void detect_task(void *arg)
{
    uint32_t next = 0;          // next ring index to examine
    uint32_t peak_idx = 0;
    float peak_mag = 0;
    uint32_t last_strike_us = 0;
    int still_run = 0;
    enum { SEEK, IN_PEAK, WAIT_STILL } st = SEEK;

    for (;;) {
        if (next >= fusion_count()) { vTaskDelay(pdMS_TO_TICKS(5)); continue; }
        fused_sample_t f;
        if (!fusion_get(next, &f)) { next = fusion_count(); continue; }
        uint32_t idx = next++;

        float mag = sqrtf(f.raw.ax * f.raw.ax + f.raw.ay * f.raw.ay + f.raw.az * f.raw.az);
        float mag_w = sqrtf(f.ax_f * f.ax_f + f.ay_f * f.ay_f + f.az_f * f.az_f);

        switch (st) {
        case SEEK:
            // The motor on this ankle shakes the IMU; never start a candidate while it runs.
            if (mag > STRIKE_PEAK_G && !haptic_blanked(f.t_us) && f.t_us - last_strike_us > STRIKE_REFRACT_MS * 1000) {
                st = IN_PEAK; peak_idx = idx; peak_mag = mag;
            }
            break;
        case IN_PEAK:
            if (mag > peak_mag) { peak_mag = mag; peak_idx = idx; }
            if (mag < STRIKE_PEAK_G) { st = WAIT_STILL; still_run = 0; }
            break;
        case WAIT_STILL:
            still_run = (mag_w < STRIKE_STILL_G) ? still_run + 1 : 0;
            if (still_run * (1000 / IMU_RATE_HZ) >= STRIKE_STILL_MS && idx >= peak_idx + WIN_POST_SAMPLES) {
                step_window_t w = { .t_strike_us = 0 };
                fused_sample_t p;
                if (fusion_get(peak_idx, &p)) w.t_strike_us = p.t_us;
                cut_window(peak_idx, &w);
                if (xQueueSend(window_q, &w, 0) != pdTRUE) DT_LOGW(TAG, "window_q full");
                last_strike_us = w.t_strike_us;
                st = SEEK;
            } else if (idx > peak_idx + 60) {
                st = SEEK;  // never settled; not a step
            }
            break;
        }
    }
}
